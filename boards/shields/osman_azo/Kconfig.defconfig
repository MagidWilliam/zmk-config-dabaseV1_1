## boards/shields/osman_azo/Kconfig.defconfig
```kconfig
if SHIELD_CORNE_WITH_AZO_LEFT

config ZMK_KEYBOARD_NAME
    default "corne_with_azo"

config ZMK_SPLIT_BLE_ROLE_CENTRAL
     default y

endif

if SHIELD_CORNE_WITH_AZO_RIGHT

config ZMK_KEYBOARD_NAME
    default "corne_with_azo_R"

endif

if SHIELD_CORNE_WITH_AZO_LEFT || SHIELD_CORNE_WITH_AZO_RIGHT

config ZMK_SPLIT
     default y
endif
```

## boards/shields/osman_azo/Kconfig.shield
```kconfig
config SHIELD_CORNE_WITH_AZO_LEFT
    def_bool $(shields_list_contains, corne_with_azo_left)

config SHIELD_CORNE_WITH_AZO_RIGHT
    def_bool $(shields_list_contains,corne_with_azo_right)
```

## config/boards/shields/dac_man_5x6/Kconfig.defconfig
```kconfig
if SHIELD_DAC_MAN_5X6_LEFT

config ZMK_KEYBOARD_NAME
    default "Corne-Severed-L"

config ZMK_SPLIT_BLE_ROLE_CENTRAL
    default y
    
endif

if SHIELD_DAC_MAN_5X6_RIGHT

config ZMK_KEYBOARD_NAME
    default "Corne-Severed-R"

config IQS5XX
    bool
    default y

# enable pointing
config ZMK_POINTING
    default y

config INPUT
    default y
    
endif

if SHIELD_DAC_MAN_5X6_LEFT || SHIELD_DAC_MAN_5X6_RIGHT

config ZMK_SPLIT
    default y
endif
```

## config/west.yml
```yaml
manifest:
  remotes:
    - name: zmkfirmware
      url-base: https://github.com/zmkfirmware
    - name: ahmed-m-osman1
      url-base: https://github.com/Ahmed-M-Osman1
  projects:
    - name: zmk
      remote: zmkfirmware
      revision: main
      import: app/west.yml
    - name: zmk-driver-azoteq
      remote: ahmed-m-osman1
      # branch:
      revision: main
  self:
    path: config
```
